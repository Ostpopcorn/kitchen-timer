## main/Kconfig.projbuild
```kconfig
menu "Timer configuration"
    config SCREEN_STARTUP_MESSAGE
        string "Screen startup message"
        default "HEJ"
        help
            Välj vad som ska stå på skärmen när configurationen är klar!
endmenu
```

## sdkconfig.defaults
```kconfig
CONFIG_PARTITION_TABLE_CUSTOM=y
CONFIG_PARTITION_TABLE_CUSTOM_FILENAME="partition_table.csv"
CONFIG_PARTITION_TABLE_FILENAME="partition_table.csv"
CONFIG_COMPILER_CXX_RTTI=y
```
